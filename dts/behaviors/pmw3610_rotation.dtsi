/*
 * Copyright (c) 2026 Tano Karbou (github: karbou12 / X: @karbou_12)
 *
 * SPDX-License-Identifier: MIT
 */

#include <dt-bindings/zmk/behaviors.h>
#include <dt-bindings/zmk/pmw3610_rotation.h>

/ {
    behaviors {
#if ZMK_BEHAVIOR_OMIT(TB_ROT_45)
        /omit-if-no-ref/
#endif
        tb_rot_45: tr45 {
            compatible = "zmk,behavior-pmw3610-rotation";
            #binding-cells = <1>;
            step-angle-degree = <45>;
            display-name = "PMW3610 Trackball Rotation with 45 degree";
        };

#if ZMK_BEHAVIOR_OMIT(ENC_TB_ROT_45)
        /omit-if-no-ref/
#endif
        enc_tb_rot_45: enc_tr45 {
            compatible = "zmk,behavior-sensor-rotate";
            #sensor-binding-cells = <0>;
            bindings = <&tb_rot_45 ROT_CCW>, <&tb_rot_45 ROT_CW>;
        };
    };
};
